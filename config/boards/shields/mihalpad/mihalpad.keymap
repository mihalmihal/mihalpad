#include <behaviors.dtsi>
#include <dt-bindings/zmk/keys.h>
#include <dt-bindings/zmk/bt.h>
#include <dt-bindings/zmk/outputs.h>

/ {
    keymap {
        compatible = "zmk,keymap";

        default_layer {
            bindings = <
                &kp A &kp B &kp C &kp D &kp E &kp F &kp G &kp H &kp I &bt BT_CLR_ALL &kp K &kp L &kp M &kp N &kp P &kp Q &kp R &kp S
            >;
        };
    };
};